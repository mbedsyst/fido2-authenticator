## CMakeLists.txt
```
# SPDX-License-Identifier: Apache-2.0

cmake_minimum_required(VERSION 3.20.0)

find_package(Zephyr REQUIRED HINTS $ENV{ZEPHYR_BASE})
project(FIDO2_Key)

zephyr_include_directories(${CMAKE_CURRENT_SOURCE_DIR})

target_include_directories(app PRIVATE
        ${CMAKE_CURRENT_SOURCE_DIR}/src/app
        ${CMAKE_CURRENT_SOURCE_DIR}/src/interfaces/transport
        ${CMAKE_CURRENT_SOURCE_DIR}/src/interfaces/ui
        ${CMAKE_CURRENT_SOURCE_DIR}/src/drivers/transport
        ${CMAKE_CURRENT_SOURCE_DIR}/src/drivers/ui
)

target_sources(app PRIVATE 
        src/app/main.c
        src/app/app_ctx.c
        src/app/fido_main.c
        src/drivers/ui/led_controller.c
        src/drivers/ui/button_controller.c
        src/drivers/transport/usb_transport.c
)
```

## sample.yaml
```
sample:
  name: FIDO2 Authenticator
  description: >
    A sample FIDO2 Authenticator implementation using USB HID.
    Demonstrates USB enumeration, descriptor parsing, and CBOR-based FIDO2 messaging.

tests:
  sample.app.fido2:
    integration_platforms:
      - nrf52840dk_nrf52840
    tags:
      - usb
      - hid
      - fido2
      - security
      - authentication
    filter: CONFIG_USB_DEVICE_STACK and CONFIG_USB_HID_DEVICE
    harness: console
```

## prj.conf
```kconfig
CONFIG_USB_DEVICE_STACK=y
CONFIG_USB_DEVICE_HID=y
CONFIG_USB_DEVICE_PRODUCT="Zephyr HID mouse sample"
CONFIG_USB_DEVICE_PID=0x0007
CONFIG_USB_DEVICE_INITIALIZE_AT_BOOT=n

CONFIG_LOG=y
CONFIG_USB_DRIVER_LOG_LEVEL_ERR=y
CONFIG_USB_DEVICE_LOG_LEVEL_ERR=y

CONFIG_GPIO=y
CONFIG_REBOOT=y

# Logger Configurations
CONFIG_LOG_DEFAULT_LEVEL=3
CONFIG_LOG_BACKEND_SHOW_COLOR=y 
```

## app.overlay
```dts
/ {
    hid_dev_0: hid_dev_0 {
        compatible = "zephyr,hid-device";
        status = "okay";
        interface-name = "HID0";
        in-report-size = <64>;
        in-polling-period-us = <1000>;
        out-report-size = <64>;
        out-polling-period-us = <1000>;
    };
};
```

## src/main.c
```c
#include <zephyr/kernel.h>
#include <zephyr/device.h>
#include <zephyr/drivers/uart.h>

#include <string.h>

#include "logger.h"

#define UART_NODE DT_CHOSEN(zephyr_shell_uart)

int main(void)
{
    const struct device *uart0 = DEVICE_DT_GET(UART_NODE);

    if (log_init(uart0, LOG_LEVEL_DEBUG) != 0) 
	{
        printk("Logger failed to init\n");
        return 0;
    }

	while(1)
	{
		log_debug("Debug value: %d", 42);
		log_info("System up, built for nRF52840-DK");
		log_warn("Warning, this could breach constant time rule.");
		log_error("Something went wrong!");
		k_msleep(1000);
	}

	return 0;
}
```
