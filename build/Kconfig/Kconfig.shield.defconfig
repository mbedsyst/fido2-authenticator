## build/Kconfig/boards/Kconfig.defconfig
```kconfig
# Load Zephyr board defconfig descriptions.
osource "/home/mbedsyst/ncs/v3.0.0/zephyr/boards/nordic/nrf52840dk/Kconfig.defconfig"
```

## build/Kconfig/boards/Kconfig.nrf52840dk
```kconfig
# Load board Kconfig descriptions.
osource "/home/mbedsyst/ncs/v3.0.0/zephyr/boards/nordic/nrf52840dk/Kconfig.nrf52840dk"
```

## build/fido2_authenticator/Kconfig/arch/Kconfig
```kconfig
# Load Zephyr Arch Kconfig descriptions.
osource "/home/mbedsyst/ncs/v3.0.0/zephyr/arch/x86/Kconfig"
osource "/home/mbedsyst/ncs/v3.0.0/zephyr/arch/xtensa/Kconfig"
osource "/home/mbedsyst/ncs/v3.0.0/zephyr/arch/sparc/Kconfig"
osource "/home/mbedsyst/ncs/v3.0.0/zephyr/arch/riscv/Kconfig"
osource "/home/mbedsyst/ncs/v3.0.0/zephyr/arch/posix/Kconfig"
osource "/home/mbedsyst/ncs/v3.0.0/zephyr/arch/nios2/Kconfig"
osource "/home/mbedsyst/ncs/v3.0.0/zephyr/arch/mips/Kconfig"
osource "/home/mbedsyst/ncs/v3.0.0/zephyr/arch/arm64/Kconfig"
osource "/home/mbedsyst/ncs/v3.0.0/zephyr/arch/arm/Kconfig"
osource "/home/mbedsyst/ncs/v3.0.0/zephyr/arch/arc/Kconfig"
```

## build/fido2_authenticator/Kconfig/boards/Kconfig.sysbuild
```kconfig
# Load Sysbuild board Kconfig descriptions.
osource "/home/mbedsyst/ncs/v3.0.0/zephyr/boards/nordic/nrf52840dk/Kconfig.sysbuild"
```
